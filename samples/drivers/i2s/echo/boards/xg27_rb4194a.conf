## samples/drivers/i2s/echo/boards/xg27_rb4194a.conf
```kconfig
# SPDX-FileCopyrightText: Copyright (c) 2026 Silicon Laboratories Inc.
# SPDX-License-Identifier: Apache-2.0

CONFIG_DMA=y
CONFIG_SAMPLE_FREQ=16000
CONFIG_I2S_SILABS_USART_TX_BLOCK_COUNT=8
CONFIG_I2S_SILABS_USART_RX_BLOCK_COUNT=8
CONFIG_AUDIO=n
CONFIG_AUDIO_CODEC=n
CONFIG_STOP_START_STREAMS_SW1=n
```

## tests/drivers/i2s/i2s_api/Kconfig
```kconfig
#
# Copyright (c) 2021, NXP
#
# SPDX-License-Identifier: Apache-2.0
#

mainmenu "I2S Loopback Test"

source "Kconfig.zephyr"

config I2S_TEST_SEPARATE_DEVICES
	bool "Use two separate I2S ports for loopback"
	help
	  Use separate I2S ports for transmit and receive.

config I2S_TEST_USE_I2S_DIR_BOTH
	bool "Use I2S_DIR_BOTH value to perform RX/TX transfers"
	default y if DT_HAS_NORDIC_NRF_I2S_ENABLED || DT_HAS_NORDIC_NRF_TDM_ENABLED
	help
	  Use the I2S_DIR_BOTH enumeration value to trigger commands in test
	  cases involving both reception and transmission. Use of this option
	  is essential for devices that cannot independently start and stop
	  the RX and TX streams.

config I2S_TEST_BIT_CLK_GATED
	bool "Request I2S_OPT_BIT_CLK_GATED in test configurations"
	default y if DT_HAS_SILABS_USART_I2S_ENABLED
	help
	  Add I2S_OPT_BIT_CLK_GATED to every stream configuration. Needed by
	  drivers whose bit clock only runs while data is streamed.

config I2S_TEST_RX_CONTROLLER
	bool "Configure the RX stream as bit/frame clock controller"
	default y if DT_HAS_SILABS_USART_I2S_ENABLED
	help
	  Use controller mode for RX as well, for ports that cannot be a
	  clock target and share the TX-driven bus clock.

config I2S_TEST_USE_GPIO_LOOPBACK
	bool "Use GPIO loopback"
	default y if DT_HAS_NORDIC_NRF_I2S_ENABLED || DT_HAS_NORDIC_NRF_TDM_ENABLED
	default y if DT_HAS_SILABS_USART_I2S_ENABLED
	help
	  Use wiring between the data-out and data-in pins for looping back
	  data. This option is intended to be used for devices that do not
	  provide the internal loopback functionality.

config I2S_TEST_ALLOWED_DATA_OFFSET
	int "Allowed offset in received data"
	default 2 if DT_HAS_NORDIC_NRF_I2S_ENABLED || DT_HAS_NORDIC_NRF_TDM_ENABLED
	default 0
	help
	  Maximum allowed offset between sent and received samples. Non-zero
	  value of this option may be needed when GPIO loopback is used.

config I2S_TEST_ALLOW_VARIABLE_OFFSET
	bool "Recalculate the data offset on every block read"
	help
	  If the data offset is not consistent between reads because of
	  timing variations in the hardware, enable this option to
	  always recalculate the offset.
```

## tests/drivers/i2s/i2s_api/boards/xg27_dk2602a.conf
```kconfig
# Copyright (c) 2026 Silicon Laboratories Inc.
# SPDX-License-Identifier: Apache-2.0

CONFIG_I2S_TEST_USE_GPIO_LOOPBACK=y
CONFIG_I2S_TEST_RX_CLK_CONTROLLER=y
CONFIG_I2S_TEST_BIT_CLK_GATED=y
CONFIG_I2S_TEST_ALLOWED_DATA_OFFSET=2
CONFIG_I2S_TEST_SKIP_RX_SYNC_START=y
```
